## dts/bindings/ethernet/davicom,dm9051.yaml
```yaml
# Copyright (c) 2025 - 2026, Davicom, Inc. Limited
# SPDX-License-Identifier: Apache-2.0

description: DM9051 standalone 10/100BASE-T Ethernet controller with SPI interface

compatible: "davicom,dm9051"

include: [spi-device.yaml, ethernet-controller.yaml]

properties:
  int-gpios:
    type: phandle-array
    required: true
    description: Interrupt pin.

      The interrupt pin of DM9051 is active low.
      If connected directly the MCU pin should be configured
      as active low.
  reset-gpios:
    type: phandle-array
    description: Reset pin.

      The reset pin of DM9051 is active low.
      If connected directly the MCU pin should be configured
      as active low.
```
